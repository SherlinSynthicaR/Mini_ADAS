VERSION ""

NS_ :

BS_:

BU_: Headlight Sensor
VAL_TABLE_ Light 1 "ON" 0 "OFF" ;

BO_ 256 Sensor_msg: 8 Sensor
 SG_ Speed_sig : 8|8@1+ (1,0) [0|240] "" Vector__XXX
 SG_ Amb_sig : 0|8@1+ (1,0) [0|100] "" Vector__XXX

BO_ 512 Headlight_msg: 8 Headlight
 SG_ Headlight_sig : 0|8@1+ (1,0) [0|2] "" Vector__XXX

VAL_ 512 Headlight_sig 2 "HIGH BEAM" 1 "LOW BEAM" 0 "OFF" ;
